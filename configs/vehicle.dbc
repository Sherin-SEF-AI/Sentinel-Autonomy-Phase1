VERSION ""

NS_ :

BS_:

BU_: Vector__XXX

BO_ 256 VehicleSpeed: 8 Vector__XXX
 SG_ Speed : 0|16@1+ (0.01,0) [0|655.35] "m/s" Vector__XXX

BO_ 512 SteeringAngle: 8 Vector__XXX
 SG_ Angle : 0|16@1- (0.001,-32.768) [-32.768|32.767] "rad" Vector__XXX

BO_ 768 BrakePressure: 8 Vector__XXX
 SG_ Pressure : 0|16@1+ (0.1,0) [0|6553.5] "bar" Vector__XXX

BO_ 1024 ThrottlePosition: 8 Vector__XXX
 SG_ Position : 0|16@1+ (0.0001,0) [0|1] "" Vector__XXX

BO_ 1280 GearPosition: 8 Vector__XXX
 SG_ Gear : 0|8@1- (1,0) [-1|6] "" Vector__XXX

BO_ 1536 TurnSignal: 8 Vector__XXX
 SG_ Signal : 0|8@1+ (1,0) [0|2] "" Vector__XXX

BO_ 1792 BrakeCommand: 8 Vector__XXX
 SG_ BrakeCommand : 0|16@1+ (0.0001,0) [0|1] "" Vector__XXX

BO_ 2048 SteeringCommand: 8 Vector__XXX
 SG_ SteeringCommand : 0|16@1- (0.001,-32.768) [-32.768|32.767] "rad" Vector__XXX

CM_ BO_ 256 "Vehicle speed from wheel sensors";
CM_ SG_ 256 Speed "Vehicle speed in meters per second";
CM_ BO_ 512 "Steering wheel angle";
CM_ SG_ 512 Angle "Steering angle in radians (positive = left)";
CM_ BO_ 768 "Brake system pressure";
CM_ SG_ 768 Pressure "Brake pressure in bar";
CM_ BO_ 1024 "Throttle pedal position";
CM_ SG_ 1024 Position "Throttle position 0-1 (0=released, 1=full)";
CM_ BO_ 1280 "Gear selector position";
CM_ SG_ 1280 Gear "Gear number (-1=R, 0=N, 1-6=forward gears)";
CM_ BO_ 1536 "Turn signal indicator";
CM_ SG_ 1536 Signal "Turn signal state (0=none, 1=left, 2=right)";
CM_ BO_ 1792 "Brake intervention command";
CM_ SG_ 1792 BrakeCommand "Brake command 0-1 (0=no brake, 1=full brake)";
CM_ BO_ 2048 "Steering intervention command";
CM_ SG_ 2048 SteeringCommand "Steering command in radians";
BA_DEF_ "BusType" STRING ;
BA_DEF_ BO_  "GenMsgCycleTime" INT 0 10000;
BA_DEF_DEF_  "BusType" "CAN";
BA_DEF_DEF_  "GenMsgCycleTime" 0;
BA_ "GenMsgCycleTime" BO_ 256 10;
BA_ "GenMsgCycleTime" BO_ 512 10;
BA_ "GenMsgCycleTime" BO_ 768 10;
BA_ "GenMsgCycleTime" BO_ 1024 10;
BA_ "GenMsgCycleTime" BO_ 1280 100;
BA_ "GenMsgCycleTime" BO_ 1536 100;
VAL_ 1536 Signal 0 "None" 1 "Left" 2 "Right" ;
VAL_ 1280 Gear -1 "Reverse" 0 "Neutral" 1 "First" 2 "Second" 3 "Third" 4 "Fourth" 5 "Fifth" 6 "Sixth" ;
